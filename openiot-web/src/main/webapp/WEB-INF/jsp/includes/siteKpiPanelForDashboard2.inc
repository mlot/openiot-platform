<%--
  ~ Copyright (c) SiteWhere, LLC. All rights reserved. http://www.sitewhere.com
  ~
  ~ The software in this package is published under the terms of the CPAL v1.0
  ~ license, a copy of which has been included with this distribution in the
  ~ LICENSE.txt file.
  --%>

<script type="text/x-kendo-template" id="tpl-site-kpi-panel-for-dashboard2">
	<div>
		<div id="db2-kpi-pie" class="db2-kpi-con"></div>
		<div id="db2-kpi-block1" class="db2-kpi-con">
			<span><em id="two_kpi_1">65</em>%</span>
			<p>humidity</p>
		</div>
		<div id="db2-kpi-block2" class="db2-kpi-con">
			<strong><em id="two_kpi_2">60</em>Hz</strong>
			<p>frequency</p>
		</div>
		<div id="db2-kpi-block3" class="db2-kpi-con">
			<strong><em id="two_kpi_4">14</em>K</strong>
			<p>network flow</p>
		</div>
		<div id="db2-kpi-block4" class="db2-kpi-con">
			<strong id="two_kpi_5">2286</strong>
			<p>Connection</p>
		</div>
		<div id="db2-kpi-block5" class="db2-kpi-con">
			<strong><em id="two_kpi_6">80</em>db</strong>
			<p>Volume</p>
		</div>
    </div>
</script>
